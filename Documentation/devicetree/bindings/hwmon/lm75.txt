## Documentation/devicetree/bindings/hwmon/lm75.txt
```
* LM75 series thermometer.

Required node properties:
- compatible: manufacturer and chip name, one of
	"national,lm75"

- reg: I2C bus address of the device

Example LM75 node:

sensor {
	compatible = "national,lm75";
	reg = <0x48>;
}
```

## Documentation/devicetree/bindings/misc/at24.txt
```
EEPROMs (I2C) compatible with Atmel at24.

Required properties:
- compatible : "atmel,at24"
- reg : I2C address
- size : total eeprom size in bytes
- pagesize : size of the eeprom page

Optional properties:
- address-width : number of address bits (8 or 16).  Defaults to 8.
- read-only : if exists, prevents writes to the eeprom device.
- world-readable : if exists, makes the eeprom device world readable.
- fixed-addrs : set a fixed number of I2C addresses for the device.  If
  present, must be 8.

Additional compatible properties are also allowed.

Example:

eeprom@0 {
	compatible = "atmel,at24c02d", "atmel,at24";
	reg = <0x57>
	pagesize = <8>;
	size = <256>;
};
```

## drivers/swc/Kconfig
```kconfig
#
# Switch Complex Drivers Configuration
#

menuconfig SWC
	tristate "Switch Complex Support"
	default n
	help
	  Network Switch Complex devices provide platform data and control for
	  network switch platforms.

	  This support can also be built as a module.  If so, the module
	  will be called swc.

if SWC

config SWC_FW
	tristate "Firmware Defined Switch Complex Driver"
	default n
	help
	  Support for firmware-backed (OF or ACPI) switch complex
	  configuration.

	  This support can also be built as a module.  If so, the module
	  will be called swc-fw.

config SWC_CPLD
	tristate "Firmware Defined Multifunction Device"
	select REGMAP_I2C
	help
	  Select this option to enable accessing switch complex system
	  registers defined via device properties.

	  This support can also be built as a module.  If so, the module
	  will be called swc-cpld.


config SWC_CPLD_GPIO
	tristate "Firmware Defined GPIO Device"
	depends on SWC_CPLD
	help
	  Select this option to enable accessing GPIO pins defined via device
	  properties.

config SWC_CPLD_REGISTER
	tristate "Firmware Defined Register Device"
	depends on SWC_CPLD
	help
	  Select this option to enable accessing registers defined via device
	  properties.

config SWC_CPLD_I2C_MUX
	tristate "Firmware Defined I2C Mux Device"
	depends on SWC_CPLD
	help
	  Select this option to enable accessing I2C multiplexers defined via
	  device properties.

config SWC_FAN
	tristate "Firmware Defined Fan"
	help
	  Select this option to enable control and monitoring of fan devices
	  defined via device properties.

config SWC_LED
	tristate "Firmware Defined LED"
	help
	  Select this option to enable controling LEDs defined via device
	  properties.

config SWC_PSU
	tristate "Firmware Defined PSU"
	help
	  Select this option to enable power supply monitoring defined via
	  device properties.

config SWC_THERMAL
	tristate "Firmware Defined Thermal Zones"
	help
	  Select this option to enable thermal zones defined via device
	  properties.

config SWP
	tristate "Switch Port Support"
	default n
	help
	  Network Switch Port devices provide platform data and control for
	  network switch ports.

	  This support can also be built as a module.  If so, the module
	  will be called swp.

config SWP_FW
	tristate "Firmware Defined Switch Port Driver"
	depends on SWP
	default n
	help
	  Support for firmware-backed (OF or ACPI) switch port configuration.

	  This support can also be built as a module.  If so, the module
	  will be called swp-fw.

config SFF
	tristate "Small Form Factor Pluggable Transceiver Support"
	default n
	help
	  Small Form Factor Pluggable Transceiver devices provide platform data
	  and control for SFF pluggables defined by the MSA.

	  This support can also be built as a module.  If so, the module
	  will be called sff.

config SFF_TWI
	tristate "Small Form Factor Pluggable Serial Interface Support"
	depends on SFF
	default n
	help
	  Provides access to the two-wire serial interface of a SFF module.

	  This support can also be built as a module.  If so, the module
	  will be called sff-twi.

config SFF_FW
	tristate "Firmware Defined Small Form Factor Pluggable Transceiver Driver"
	depends on SFF_TWI
	default n
	help
	  Support for firmware-backed (OF or ACPI) SFF transcievers.

	  This support can also be built as a module.  If so, the module
	  will be called sff-fw.

config SWC_DEBUG
	bool "Enable Debugging"
	default n
	help
	  Say Y here to enable debugging messages.

endif
```
